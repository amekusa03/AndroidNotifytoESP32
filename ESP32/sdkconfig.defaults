## ESP32/sdkconfig.defaults
```kconfig
CONFIG_IDF_TARGET="esp32"

# Bluetooth Classic (SPP) 設定
CONFIG_BT_ENABLED=y
CONFIG_BTDM_CTRL_MODE_BR_EDR_ONLY=y
CONFIG_BT_BLUEDROID_ENABLED=y
CONFIG_BT_CLASSIC_ENABLED=y
CONFIG_BT_SPP_ENABLED=y

# Wi-Fi + BT Dual Mode 用 IRAM & DRAM 最適化
CONFIG_ESP_WIFI_IRAM_OPT=n
CONFIG_ESP_WIFI_RX_IRAM_OPT=n
CONFIG_FREERTOS_PLACE_FUNCTIONS_INTO_FLASH=y
CONFIG_COMPILER_OPTIMIZATION_SIZE=y
CONFIG_COMPILER_OPTIMIZATION_DEBUG=n

# Wi-Fi バッファ削減 (DRAM 節約)
CONFIG_ESP_WIFI_STATIC_RX_BUFFER_NUM=4
CONFIG_ESP_WIFI_DYNAMIC_RX_BUFFER_NUM=16
CONFIG_ESP_WIFI_DYNAMIC_TX_BUFFER_NUM=16
CONFIG_ESP_WIFI_MGMT_SBUF_NUM=6

# 大容量 (Single Factory App, Large 1.5MB+) パーティションテーブル
CONFIG_PARTITION_TABLE_SINGLE_APP_LARGE=y




```
